## sdkconfig.defaults
```kconfig
# Rust stack size
CONFIG_ESP_MAIN_TASK_STACK_SIZE=30000

# Bluetooth configuration (Dual Mode for stability)
CONFIG_BT_ENABLED=y
CONFIG_BT_BLUEDROID_ENABLED=y
CONFIG_BT_CLASSIC_ENABLED=y
CONFIG_BT_BLE_ENABLED=y
CONFIG_BT_SPP_ENABLED=y
CONFIG_BT_SSP_ENABLED=y

# Controller Mode
CONFIG_BTDM_CTRL_MODE_BTDM=y

# Connection limits
CONFIG_BTDM_CTRL_BR_EDR_MAX_ACL_CONN=3
CONFIG_BTDM_CTRL_BR_EDR_MAX_SYNC_CONN=0
CONFIG_BTDM_CTRL_BLE_MAX_CONN=3

# Disable modem sleep for now
CONFIG_BTDM_CTRL_MODEM_SLEEP=n

# Stacks
CONFIG_BT_BTC_TASK_STACK_SIZE=15000
CONFIG_BT_BTU_TASK_STACK_SIZE=15000

# Pinning (Bluetooth on Core 1, Main on Core 0)
CONFIG_BTDM_CTRL_PINNED_TO_CORE_1=y
CONFIG_BTDM_CTRL_PINNED_TO_CORE=1
CONFIG_BT_BLUEDROID_PINNED_TO_CORE_1=y
CONFIG_BT_BLUEDROID_PINNED_TO_CORE=1

# Watchdog
CONFIG_ESP_TASK_WDT_TIMEOUT_S=30
CONFIG_ESP_TASK_WDT_CHECK_IDLE_TASK_CPU0=n
CONFIG_ESP_TASK_WDT_CHECK_IDLE_TASK_CPU1=n
```
